# GD32EPRT register map
File version: 1.0
GD32E50x ARM 32-bit Cortex-M33 Microcontroller based device
CPU: CM33 r0p4, little endian, MPU, FPU, 4 interrupt priority bits
Registers are 32-bit, read-write, reset 0x0 unless marked. A register's access mark holds for its fields unless they carry their own. Offsets are from the block's base; lines under a group give offsets from that group; [hi:lo] are bit positions; {n}, {i} and the like mark numbered series; 'fields as' and 'values as' point back to an identical list; <NAME> marks a mode.

## Memory map
0x40000000 TIMER1 size 0x400 — General-purpose-timers
0x40000400 TIMER2 size 0x400 — General-purpose-timers
0x40000800 TIMER3 size 0x400 — General-purpose-timers
0x40000C00 TIMER4 size 0x400 — General-purpose-timers
0x40001000 TIMER5 size 0x400 — Basic-timers
0x40001400 TIMER6 size 0x400 — Basic-timers
0x40002800 RTC size 0x400 — Real-time clock
0x40002C00 WWDGT size 0x400 — Window watchdog timer
0x40003000 FWDGT size 0x400 — free watchdog timer
0x40003800 SPI1 size 0x400 — Serial peripheral interface
0x40003C00 SPI2 size 0x400 — Serial peripheral interface
0x40004400 USART1 size 0x400 — Universal synchronous asynchronous receiver transmitter
0x40004800 USART2 size 0x400 — Universal synchronous asynchronous receiver transmitter
0x40004C00 UART3 size 0x400 — Universal asynchronous receiver transmitter
0x40005000 UART4 size 0x400 — Universal asynchronous receiver transmitter
0x40005400 I2C0 size 0x400 — Inter integrated circuit
0x40005800 I2C1 size 0x400 — Inter integrated circuit
0x40005C00 USBD size 0x400 — Universal serial bus full-speed device interface
0x40006C00 BKP size 0x400 — Backup registers
0x40007000 PMU size 0x400 — Power management unit
0x40007400 DAC size 0x400 — Digital-to-analog converter
0x4000C000 I2C2 size 0x400 — Inter integrated circuit
0x4000C800 CTC size 0x400 — Clock trim controller
0x40010000 AFIO size 0x400 — Alternate-function I/Os
0x40010400 EXTI size 0x400 — External interrupt/event controller
0x40010800 GPIOA size 0x400 — General-purpose I/Os
0x40010C00 GPIOB size 0x400 — General-purpose I/Os
0x40011000 GPIOC size 0x400 — General-purpose I/Os
0x40011400 GPIOD size 0x400 — General-purpose I/Os
0x40011800 GPIOE size 0x400 — General-purpose I/Os
0x40011C00 GPIOF size 0x400 — General-purpose I/Os
0x40012000 GPIOG size 0x400 — General-purpose I/Os
0x40012400 ADC0 size 0x400 — Analog to digital converter
0x40012800 ADC1 size 0x400 — Analog to digital converter
0x40012C00 TIMER0 size 0x400 — Advanced-timers
0x40013000 SPI0 size 0x400 — Serial peripheral interface
0x40013400 TIMER7 size 0x400 — Advanced-timers
0x40013800 USART0 size 0x400 — Universal synchronous asynchronous receiver transmitter
0x40013C00 ADC2 size 0x400 — Analog to digital converter
0x40017000 USART5 size 0x400 — Universal asynchronous receiver transmitter
0x40020000 DMA0 size 0x400 — DMA controller
0x40020400 DMA1 size 0x400 — DMA controller
0x40021000 RCU size 0x400 — Reset and clock unit
0x40022000 FMC size 0x400
0x40023000 CRC size 0x400 — cyclic redundancy check calculation unit
0x40028000 ENET_MAC size 0x100 — Ethernet: media access control
0x40028100 ENET_MSC size 0x400 — Ethernet: MAC statistics counters
0x40028700 ENET_PTP size 0x400 — Ethernet: Precision time protocol
0x40029000 ENET_DMA size 0x60 — Ethernet: DMA controller operation
0x40029080 ENET_MAC_FCTH size 0x20 — MAC flow control threshold register
0xA0000000 EXMC size 0x1000 — External memory controller
0xA0001000 SQPI size 0x400 — Serial/Quad Parallel Interface
0xE000E100 NVIC size 0xF00 — Nested Vectored Interrupt Controller
0xE0044000 DBG size 0x400 — Debug support

## Interrupts
0 WWDGT
2 Tamper (BKP)
3 RTC
4 FMC
5 RCU_CTC (CTC, RCU)
6 EXTI_Line0 (EXTI)
7 EXTI_Line1 (EXTI)
8 EXTI_Line2 (EXTI)
9 EXTI_Line3 (EXTI)
10 EXTI_Line4 (EXTI)
11 DMA0_Channel0 (DMA0)
12 DMA0_Channel1 (DMA0)
13 DMA0_Channel2 (DMA0)
14 DMA0_Channel3 (DMA0)
15 DMA0_Channel4 (DMA0)
16 DMA0_Channel5 (DMA0)
17 DMA0_Channel6 (DMA0)
18 ADC0_1 (ADC0, ADC1)
19 USBD_HP (USBD)
20 USBD_LP (USBD)
23 EXTI_line9_5 (EXTI)
24 TIMER0_BRK (TIMER0)
25 TIMER0_UP (TIMER0)
26 TIMER0_TRG_CMT (TIMER0)
27 TIMER0_CC (TIMER0)
28 TIMER1
29 TIMER2
30 TIMER3
31 I2C0_EV (I2C0)
32 I2C0_ER (I2C0)
33 I2C1_EV (I2C1)
34 I2C1_ER (I2C1)
35 SPI0
36 SPI1
37 USART0
38 USART1
39 USART2
40 EXTI_line15_10 (EXTI)
41 RTC_Alarm (RTC)
42 USBD_WKUP (USBD)
43 TIMER7_BRK (TIMER7)
44 TIMER7_UP (TIMER7)
45 TIMER7_TRG_CMT (TIMER7)
46 TIMER7_CC (TIMER7)
47 ADC2
48 EXMC
50 TIMER4
51 SPI2
52 UART3
53 UART4
54 TIMER5
55 TIMER6
56 DMA1_Channel0 (DMA1)
57 DMA1_Channel1 (DMA1)
58 DMA1_Channel2 (DMA1)
59 DMA1_Channel3_DMA1_Channel4 (DMA1)
61 ENET (ENET_MAC)
62 ENET_WKUP (ENET_MAC)
82 I2C2_EV (I2C2)
83 I2C2_ER (I2C2)
84 USART5
85 I2C2_WKUP (I2C2)
86 USART5_WKUP (USART5)
